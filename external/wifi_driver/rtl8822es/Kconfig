## external/wifi_driver/rtl8822es/Kconfig
```kconfig
# SPDX-License-Identifier: GPL-2.0
config RTL8822ES
	tristate "Realtek 8822E SDIO WiFi"
	---help---
	  Help message of RTL8822ES
```

## external/wifi_driver/rtl8852be/Kconfig
```kconfig
# SPDX-License-Identifier: GPL-2.0
config RTL8852BE
	tristate "Realtek 8852B PCIE WiFi"
	depends on PCI
	---help---
	  Help message of RTL8852BE
```
